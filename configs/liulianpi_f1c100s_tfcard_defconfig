## configs/liulianpi_f1c100s_tfcard_defconfig
```kconfig
CONFIG_ARM=y
CONFIG_ARCH_SUNXI=y
CONFIG_TEXT_BASE=0x80C00000
CONFIG_DEFAULT_DEVICE_TREE="allwinner/suniv-f1c100s-liulianpi"
CONFIG_SYS_LOAD_ADDR=0x80500000
CONFIG_SPL=y
CONFIG_MACH_SUNIV=y
CONFIG_DRAM_CLK=156
CONFIG_DRAM_ZQ=0
CONFIG_VIDEO_LCD_MODE="x:480,y:272,depth:18,pclk_khz:10000,le:42,ri:8,up:11,lo:4,hs:1,vs:1,sync:3,vmode:0"
CONFIG_SPL_SPI_SUNXI=y
CONFIG_SPL_SPI_NAND_SUNXI=y
CONFIG_STACK_SIZE=0x500000
CONFIG_BOOTDELAY=1
CONFIG_USE_BOOTARGS=y
CONFIG_BOOTARGS="console=tty0 console=ttyS0,115200 panic=5 rootwait root=/dev/mmcblk0p2 earlyprintk rw"
CONFIG_BOOTCOMMAND="load mmc 0:1 0x80C00000 suniv-f1c100s-liulianpi.dtb; load mmc 0:1 0x80008000 zImage; bootz 0x80008000 - 0x80C00000"
# CONFIG_CONSOLE_MUX is not set
CONFIG_SYS_SPI_U_BOOT_OFFS=0x20000
CONFIG_CMD_CLK=y
CONFIG_CMD_MTD=y
CONFIG_CMD_MTD_OTP=y
# CONFIG_CMD_CLS is not set
CONFIG_ENV_IS_NOWHERE=y
# CONFIG_ENV_IS_IN_FAT is not set
CONFIG_MTD=y
CONFIG_DM_MTD=y
CONFIG_MTD_SPI_NAND=y
CONFIG_SPI_FLASH_WINBOND=y
CONFIG_SPI_FLASH_XTX=y
CONFIG_SPI=y
CONFIG_BMP=y
```

## configs/liulianpi_v3s_nandflash_defconfig
```kconfig
CONFIG_ARM=y
CONFIG_ARCH_SUNXI=y
CONFIG_DEFAULT_DEVICE_TREE="allwinner/sun8i-v3s-liulianpi"
CONFIG_SPL=y
CONFIG_MACH_SUN8I_V3S=y
CONFIG_DRAM_CLK=360
CONFIG_SPL_SPI_SUNXI=y
CONFIG_SPL_SPI_NAND_SUNXI=y
# CONFIG_ARMV7_NONSEC is not set
CONFIG_ARMV7_LPAE=y
CONFIG_BOOTDELAY=1
CONFIG_USE_BOOTARGS=y
CONFIG_BOOTARGS="console=ttyS0,115200 panic=5 rootwait mtdparts=spi0.0:1M(u-boot)ro,128K(dtb)ro,5120K(kernel)ro,-(rootfs) root=ubi0:rootfs earlyprintk rw rootfstype=ubifs ubi.mtd=3"
CONFIG_BOOTCOMMAND="mtd read spi-nand0 0x41800000 0x100000 0x4000; mtd read spi-nand0 0x41000000 0x120000 0x500000; bootz 0x41000000 - 0x41800000"
CONFIG_SYS_SPI_U_BOOT_OFFS=0x20000
CONFIG_CMD_MTD=y
CONFIG_CMD_MTD_OTP=y
CONFIG_OF_UPSTREAM=y
CONFIG_ENV_IS_NOWHERE=y
# CONFIG_ENV_IS_IN_FAT is not set
CONFIG_MTD=y
CONFIG_DM_MTD=y
CONFIG_MTD_SPI_NAND=y
CONFIG_BOOTDEV_SPI_FLASH=y
CONFIG_SPI_FLASH_WINBOND=y
CONFIG_SPI_FLASH_XTX=y
CONFIG_SPI=y
```
